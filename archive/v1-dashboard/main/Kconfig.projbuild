## archive/v1-dashboard/main/Kconfig.projbuild
```kconfig
menu "T-Dongle-C5 dashboard"

config FB_DUMP
    bool "Dump rendered frames to the console (debug)"
    default n
    help
        Base64-encodes each rendered framebuffer to the console so
        tools/fbview.py can turn it back into a PNG on the host. Lets you
        review the panel layout without looking at the panel. Cycles through
        the screens automatically while enabled. Leave off for normal builds.

endmenu
```

## main/Kconfig.projbuild
```kconfig
menu "netstick"

config FB_DUMP
    bool "Debug: drive the UI over the console and dump frames"
    default n
    help
        Installs the USB-Serial-JTAG driver so the host can send 't' (tap),
        'h' (hold) and 'd' (dump the current frame as base64) over the
        console. tools/fbview.py turns the dumps into PNGs. Debug builds only:
        with the driver installed, console output blocks when nothing is
        reading the port.

endmenu
```
